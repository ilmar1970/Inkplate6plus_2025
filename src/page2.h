#include "Arduino.h"
#include "Inkplate.h"
#include "Fonts/FreeSansBold24pt7b.h"

extern Inkplate display;

int bitmap1_x = 230; // Water
int bitmap1_y = 65;
const int bitmap1_w = 60;
const int bitmap1_h = 60;

const uint8_t water[] PROGMEM = {
0x00, 0x00, 0x00, 0x00, 0x00, 0x00, 0x00, 0x00, 0x00, 0x00, 0x00, 0x00,
  0x00, 0x00, 0x00, 0x00, 0x00, 0x00, 0x00, 0x00, 0x00, 0x00, 0x00, 0x00,
  0x00, 0x00, 0x00, 0x00, 0x00, 0x00, 0x00, 0x00, 0x00, 0x00, 0x00, 0x00,
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  0x00, 0x00, 0x00, 0x00, 0x00, 0x00, 0x00, 0x00, 0x00, 0x00, 0x00, 0x00,
};

int bitmap0_x = bitmap1_x + 514; // Diesel
int bitmap0_y = 65;
const int bitmap0_w = 60;
const int bitmap0_h = 60;

const uint8_t diesel[] PROGMEM = {
  0x00, 0x00, 0x00, 0x00, 0x00, 0x00, 0x00, 0x00, 0x00, 0x00, 0x00, 0x00,
  0x00, 0x00, 0x00, 0x00, 0x00, 0x00, 0x00, 0x00, 0x00, 0x00, 0x00, 0x00,
  0x00, 0x00, 0x00, 0x00, 0x00, 0x00, 0x00, 0x00, 0x00, 0x00, 0x00, 0x00,
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  0x00, 0x00, 0x00, 0x00, 0x00, 0x00, 0x00, 0x00, 0x00, 0x00, 0x00, 0x00,
};

int rect0_a_x = 100;
int rect0_a_y = 220;
int rect0_b_x = rect0_a_x + 140;
int rect0_b_y = rect0_a_y + 260;
int rect0_fill = -1;
int rect0_radius = -1;
int rect0_color = 0;

int rect1_a_x = rect0_a_x + 180;
int rect1_a_y = rect0_a_y;
int rect1_b_x = rect1_a_x + 140;
int rect1_b_y = rect1_a_y + 260;
int rect1_fill = -1;
int rect1_radius = -1;
int rect1_color = 0;

int rect2_a_x = 1024 - rect1_a_x - rect0_a_x - 40;
int rect2_a_y = rect0_a_y;
int rect2_b_x = rect2_a_x + 140;
int rect2_b_y = rect2_a_y + 260;
int rect2_fill = -1;
int rect2_radius = -1;
int rect2_color = 0;

int rect3_a_x = rect2_a_x + 180;
int rect3_a_y = rect0_a_y;
int rect3_b_x = rect3_a_x + 140;
int rect3_b_y = rect3_a_y + 260;
int rect3_fill = -1;
int rect3_radius = -1;
int rect3_color = 0;

String text2_content = "DP %";
int text2_cursor_x = 120;
int text2_cursor_y = 200;
const GFXfont *text2_font = &FreeSansBold24pt7b;

String text3_content = "DS %";
int text3_cursor_x = text2_cursor_x + rect1_a_x - 100;
int text3_cursor_y = text2_cursor_y;
const GFXfont *text3_font = &FreeSansBold24pt7b;

String text4_content = "WP %";
int text4_cursor_x = text2_cursor_x + rect2_a_x - 100;
int text4_cursor_y = text2_cursor_y;
const GFXfont *text4_font = &FreeSansBold24pt7b;

String text5_content = "WS %";
int text5_cursor_x = text2_cursor_x + rect3_a_x - 100;
int text5_cursor_y = text2_cursor_y;
const GFXfont *text5_font = &FreeSansBold24pt7b;

// int circle0_center_x = 428;
// int circle0_center_y = 720;
// int circle0_fill = 1;
// int circle0_radius = 10;
// int circle0_color = 0;

// int circle1_center_x = 493;
// int circle1_center_y = 720;
// int circle1_fill = -1;
// int circle1_radius = 10;
// int circle1_color = 0;

void mainDraw() {
    display.drawBitmap3Bit(bitmap0_x, bitmap0_y, diesel, bitmap0_w, bitmap0_h);
    display.drawBitmap3Bit(bitmap1_x, bitmap1_y, water, bitmap1_w, bitmap1_h);
    if (rect0_radius != -1 && rect0_fill != -1)
       display.fillRoundRect(rect0_a_x, rect0_a_y, rect0_b_x - rect0_a_x, rect0_b_y - rect0_a_y, rect0_radius, rect0_color);
   else if (rect0_radius != -1 && rect0_fill == -1)
       display.drawRoundRect(rect0_a_x, rect0_a_y, rect0_b_x - rect0_a_x, rect0_b_y - rect0_a_y, rect0_radius, rect0_color);
   else if (rect0_radius == -1 && rect0_fill != -1)
       display.fillRect(rect0_a_x, rect0_a_y, rect0_b_x - rect0_a_x, rect0_b_y - rect0_a_y, rect0_color);
   else if (rect0_radius == -1 && rect0_fill == -1)
       display.drawRect(rect0_a_x, rect0_a_y, rect0_b_x - rect0_a_x, rect0_b_y - rect0_a_y, rect0_color);

    if (rect1_radius != -1 && rect1_fill != -1)
       display.fillRoundRect(rect1_a_x, rect1_a_y, rect1_b_x - rect1_a_x, rect1_b_y - rect1_a_y, rect1_radius, rect1_color);
   else if (rect1_radius != -1 && rect1_fill == -1)
       display.drawRoundRect(rect1_a_x, rect1_a_y, rect1_b_x - rect1_a_x, rect1_b_y - rect1_a_y, rect1_radius, rect1_color);
   else if (rect1_radius == -1 && rect1_fill != -1)
       display.fillRect(rect1_a_x, rect1_a_y, rect1_b_x - rect1_a_x, rect1_b_y - rect1_a_y, rect1_color);
   else if (rect1_radius == -1 && rect1_fill == -1)
       display.drawRect(rect1_a_x, rect1_a_y, rect1_b_x - rect1_a_x, rect1_b_y - rect1_a_y, rect1_color);

    if (rect2_radius != -1 && rect2_fill != -1)
       display.fillRoundRect(rect2_a_x, rect2_a_y, rect2_b_x - rect2_a_x, rect2_b_y - rect2_a_y, rect2_radius, rect2_color);
   else if (rect2_radius != -1 && rect2_fill == -1)
       display.drawRoundRect(rect2_a_x, rect2_a_y, rect2_b_x - rect2_a_x, rect2_b_y - rect2_a_y, rect2_radius, rect2_color);
   else if (rect2_radius == -1 && rect2_fill != -1)
       display.fillRect(rect2_a_x, rect2_a_y, rect2_b_x - rect2_a_x, rect2_b_y - rect2_a_y, rect2_color);
   else if (rect2_radius == -1 && rect2_fill == -1)
       display.drawRect(rect2_a_x, rect2_a_y, rect2_b_x - rect2_a_x, rect2_b_y - rect2_a_y, rect2_color);

    if (rect3_radius != -1 && rect3_fill != -1)
       display.fillRoundRect(rect3_a_x, rect3_a_y, rect3_b_x - rect3_a_x, rect3_b_y - rect3_a_y, rect3_radius, rect3_color);
   else if (rect3_radius != -1 && rect3_fill == -1)
       display.drawRoundRect(rect3_a_x, rect3_a_y, rect3_b_x - rect3_a_x, rect3_b_y - rect3_a_y, rect3_radius, rect3_color);
   else if (rect3_radius == -1 && rect3_fill != -1)
       display.fillRect(rect3_a_x, rect3_a_y, rect3_b_x - rect3_a_x, rect3_b_y - rect3_a_y, rect3_color);
   else if (rect3_radius == -1 && rect3_fill == -1)
       display.drawRect(rect3_a_x, rect3_a_y, rect3_b_x - rect3_a_x, rect3_b_y - rect3_a_y, rect3_color);

    display.setFont(text2_font);
    display.setTextColor(0, 7);    display.setTextSize(1);    display.setCursor(text2_cursor_x, text2_cursor_y);
    display.print(text2_content);

    display.setFont(text3_font);
    display.setTextColor(0, 7);    display.setTextSize(1);    display.setCursor(text3_cursor_x, text3_cursor_y);
    display.print(text3_content);

    display.setFont(text4_font);
    display.setTextColor(0, 7);    display.setTextSize(1);    display.setCursor(text4_cursor_x, text4_cursor_y);
    display.print(text4_content);

    display.setFont(text5_font);
    display.setTextColor(0, 7);    display.setTextSize(1);    display.setCursor(text5_cursor_x, text5_cursor_y);
    display.print(text5_content);

//     if (circle0_fill != -1)
//        display.fillCircle(circle0_center_x, circle0_center_y, circle0_radius, circle0_color);
//    else
//        display.drawCircle(circle0_center_x, circle0_center_y, circle0_radius, circle0_color);

//     if (circle1_fill != -1)
//        display.fillCircle(circle1_center_x, circle1_center_y, circle1_radius, circle1_color);
//    else
//        display.drawCircle(circle1_center_x, circle1_center_y, circle1_radius, circle1_color);

}
